## configs/barracuda_defconfig
```kconfig
BR2_arm=y
BR2_arm920t=y
BR2_ARM_INSTRUCTIONS_THUMB=y
BR2_TOOLCHAIN_BUILDROOT_UCLIBC=y
BR2_KERNEL_HEADERS_6_1=y
BR2_GCC_VERSION_12_X=y
BR2_TOOLCHAIN_BUILDROOT_CXX=y
BR2_PACKAGE_HOST_GDB=y
BR2_PACKAGE_HOST_GDB_TUI=y
BR2_PACKAGE_HOST_GDB_PYTHON3=y
BR2_PACKAGE_HOST_GDB_SIM=y
BR2_GDB_VERSION_12=y
BR2_CCACHE=y
BR2_ENABLE_LTO=y
BR2_SHARED_STATIC_LIBS=y
BR2_TARGET_GENERIC_HOSTNAME="barracuda"
BR2_TARGET_GENERIC_ISSUE="Welcome to Barracuda"
BR2_ROOTFS_MERGED_USR=y
BR2_TARGET_GENERIC_ROOT_PASSWD="root"
BR2_SYSTEM_DEFAULT_PATH="/bin:/sbin:/usr/bin:/usr/sbin"
BR2_LINUX_KERNEL=y
BR2_LINUX_KERNEL_USE_CUSTOM_CONFIG=y
BR2_LINUX_KERNEL_CUSTOM_CONFIG_FILE="$(BR2_EXTERNAL_BARRACUDA_PATH)/board/barracuda/kernel.config"
BR2_LINUX_KERNEL_XZ=y
BR2_PACKAGE_LINUX_FIRMWARE=y
BR2_PACKAGE_LINUX_FIRMWARE_RTL_88XX=y
BR2_PACKAGE_LIBMAD=y
BR2_PACKAGE_LIBMAD_OPTIMIZATION_SPEED=y
BR2_PACKAGE_LIBSNDFILE=y
BR2_PACKAGE_OPUS=y
BR2_PACKAGE_TREMOR=y
BR2_PACKAGE_WOLFSSL=y
BR2_PACKAGE_LIBCURL=y
# BR2_PACKAGE_LIBCURL_PROXY_SUPPORT is not set
# BR2_PACKAGE_LIBCURL_COOKIES_SUPPORT is not set
# BR2_PACKAGE_LIBCURL_EXTRA_PROTOCOLS_FEATURES is not set
BR2_PACKAGE_LIBCURL_WOLFSSL=y
BR2_PACKAGE_DROPBEAR=y
# BR2_PACKAGE_DROPBEAR_CLIENT is not set
BR2_PACKAGE_USHARE=y
BR2_PACKAGE_WPA_SUPPLICANT=y
BR2_PACKAGE_WPA_SUPPLICANT_WPS=y
BR2_PACKAGE_WPA_SUPPLICANT_WPA3=y
BR2_PACKAGE_WPA_SUPPLICANT_CLI=y
BR2_PACKAGE_WPA_SUPPLICANT_PASSPHRASE=y
BR2_TARGET_ROOTFS_JFFS2=y
BR2_TARGET_ROOTFS_JFFS2_NANDFLASH_16K=y
BR2_PACKAGE_FDK_AAC_FREE_ARMV4T=y
```

## package/Config.in
```kconfig
menu "Barracuda Packages"
    source "package/fdk-aac-free-armv4t/Config.in"
endmenu
```

## package/fdk-aac-free-armv4t/Config.in
```kconfig
# These are the architectures supported by FDK AAC
config BR2_PACKAGE_FDK_AAC_FREE_ARMV4T_ARCH_SUPPORTS
	bool
	default y if BR2_aarch64
	default y if BR2_arm || BR2_armeb
	default y if BR2_i386 || BR2_x86_64
	default y if BR2_mips || BR2_mipsel || BR2_mips64 || BR2_mips64el
	default y if BR2_powerpc
	default y if BR2_sh

config BR2_PACKAGE_FDK_AAC_FREE_ARMV4T
	bool "fdk_aac_free_armv4t"
	help
	  Provides decoding of AAC format streams
	  (but without aspects of the AAC algorithm still subject to patents).
	  This was adapted for working on the ARMv4T processor of the radio,
	  representing a Third-Party Modified Version of
	  the Fraunhofer FDK AAC Codec Library for Android.
	  Modification date was 24th April 2022.
	  
	  https://www.megapico.co.uk/sharpfin/mediaserver2.html

comment "fdk-aac needs a toolchain w/ C++"
	depends on BR2_PACKAGE_FDK_AAC_FREE_ARMV4T_ARCH_SUPPORTS
	depends on !BR2_INSTALL_LIBSTDCPP
```
